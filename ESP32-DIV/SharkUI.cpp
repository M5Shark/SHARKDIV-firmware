// SharkUI.cpp — M5SHARK-style boot splash and menu chrome for SHARKDIV.
// Ported from github.com/M5Shark/M5Shark (MIT): the mark is drawn as
// character cells (6x8 GLCD font) over a noise field, decoded two rows per
// frame, glitched, then locked. ~1 KB of flash, no frame buffer.
// Mark art: the user-supplied "ASCII Skull Jaw" piece, scaled to the grid.

#include "SharkUI.h"
#include "SharkLogo.h"
#include "config.h"
#include "SettingsStore.h"

// ── palette mapping: the boot follows whatever theme is active ──
// The whole boot sequence is phosphor green (user brand choice), regardless
// of the active menu theme.
static inline uint16_t wdAccent() { return 0x07E0; }     // bright green
static inline uint16_t wdAccentDim() { return 0x02E0; }
static inline uint16_t wdContent() { return 0x05E0; }
static inline uint16_t wdLabel() { return 0x05E0; }
static inline uint16_t wdGrey() { return 0x03E0; }
static inline uint16_t wdEdge() { return 0x02E0; }
static inline uint16_t wdWarn() { return 0x07E0; }
static inline uint16_t wdMarkA() { return 0x07E0; }
static inline uint16_t wdMarkB() { return 0x05E0; }
static inline uint16_t wdMarkC() { return 0x03E0; }

// Deterministic 16 bit hash. The splash uses it instead of a frame buffer so
// every character cell can be recomputed identically on demand.
static inline uint16_t wdHash(uint16_t x, uint16_t y, uint16_t salt) {
  uint32_t h = (uint32_t)x * 73856093UL ^ (uint32_t)y * 19349663UL ^
               (uint32_t)salt * 83492791UL;
  h ^= h >> 13;
  h *= 2654435761UL;
  h ^= h >> 16;
  return (uint16_t)h;
}

// Two opposite L-shaped ticks. Cheaper than a full frame and survives the
// panel's viewing angle better than a 1 px outline alone.
static void wdCornerTicks(int16_t x, int16_t y, int16_t w, int16_t h,
                          int16_t arm, uint16_t color) {
  if (w < arm * 2 || h < arm * 2)
    return;
  tft.drawFastHLine(x, y, arm, color);
  tft.drawFastVLine(x, y, arm, color);
  tft.drawFastHLine(x + w - arm, y, arm, color);
  tft.drawFastVLine(x + w - 1, y, arm, color);
  tft.drawFastHLine(x, y + h - 1, arm, color);
  tft.drawFastVLine(x, y + h - arm, arm, color);
  tft.drawFastHLine(x + w - arm, y + h - 1, arm, color);
  tft.drawFastVLine(x + w - 1, y + h - arm, arm, color);
}

// ── ctOS menu tile ─────────────────────────────────────────────────────
void drawSharkTile(int16_t x, int16_t y, int16_t w, int16_t h, bool selected) {
  tft.startWrite();
  tft.fillRect(x, y, w, h, UI.fg);
  if (selected) {
    tft.drawRect(x, y, w, h, UI.icon);
    // Accent rail on the leading edge + corner ticks: the ctOS focus mark.
    tft.fillRect(x, y, 3, h, UI.icon);
    wdCornerTicks(x + 3, y, w - 3, h, 5, UI.accent);
  } else {
    tft.drawRect(x, y, w, h, UI.line);
  }
  tft.endWrite();
}

// List rows (submenus): selected row gets a leading accent rail.
void drawSharkRowRail(int16_t y, int16_t h, bool selected) {
  tft.startWrite();
  tft.fillRect(0, y, 4, h, selected ? UI.accent : UI_BG);
  tft.endWrite();
}

// ── boot splash ────────────────────────────────────────────────────────
namespace {

// The user's "ASCII Skull Jaw" piece at native proportions — the characters
// ARE the art, drawn verbatim (non-ASCII strokes mapped to their CP437
// glyphs). Never resample this; scaled masks destroy line art.
const uint8_t ART_COLS = 25;
const uint8_t ART_ROWS = 16;
const int16_t CELL_W = 6;
const int16_t CELL_H = 8;
const int16_t ART_X = 45;   // (240 - 25*6) / 2
const int16_t ART_Y = 118;  // art block spans y 118..246
const uint16_t WD_KEEP_COLOR = 0;

const char* const skull_art[ART_ROWS] = {
  "         _.,,,.._",
  "      ,d$$$$$$$SSIi:.",
  "    ,S$$$$$$$$$$$$SIIi:.",
  "   jI$$$$$$$$$$$$$SISSi:.",
  "  ,S$$$$$$$$$$$$$$$$$$Ii:",
  " j\xA6?$$$$$$$$$$$$$$$S$$Ii",
  " :  ?$$$$$$$$$$S7IISS$$I:",
  "j_ /$$7`\xF84$$$$7:iIS$$$$I'",
  "\xA6?\"?$$:   `$k :iIIS$$$7'",
  " \xB3  ?$L,  ,d$     $$$7'",
  ",d._J$$$$S$$$L,_\xF9'$$",
  "?$$$$$$k:?$$\xA6\xF8,  \xF8'",
  "\\:`\xF8\xA7\xA6\xF8^`:jIS7",
  "j$k,i;/_,oSSI'",
  "?SSS$$$$$?\xA6`",
  " `\xA6\xA7\xA6\xF8\"`"
};

const uint8_t noise_glyphs[16] = {'0', 'M', 'g', 'p', 'N', '#', '%', '&',
                                  '$', '4', 'X', 'W', '8', 'q', 'R', 'j'};

uint8_t artGlyph(uint8_t col, uint8_t row) {
  if (row >= ART_ROWS)
    return 0;
  const char* l = skull_art[row];
  const uint8_t len = (uint8_t)strlen(l);
  if (col >= len)
    return 0;
  const uint8_t ch = (uint8_t)l[col];
  return (ch == ' ') ? 0 : ch;
}

void drawArtCell(uint8_t col, uint8_t row, uint16_t color, int16_t dx = 0) {
  const uint8_t g = artGlyph(col, row);
  if (!g)
    return;
  tft.drawChar(ART_X + col * CELL_W + dx, ART_Y + row * CELL_H, g, color,
               TFT_BLACK, 1);
}

void drawArtRows(int16_t first_row, int16_t last_row, uint16_t color,
                 int16_t dx = 0) {
  if (first_row < 0)
    first_row = 0;
  if (last_row >= ART_ROWS)
    last_row = ART_ROWS - 1;
  for (int16_t row = first_row; row <= last_row; row++)
    for (uint8_t col = 0; col < ART_COLS; col++)
      drawArtCell(col, (uint8_t)row, color, dx);
}

void clearRows(int16_t first_row, int16_t rows) {
  tft.fillRect(ART_X - 6, ART_Y + first_row * CELL_H, ART_COLS * CELL_W + 12,
               rows * CELL_H, TFT_BLACK);
}

// Scatter of terminal glyphs over empty cells so the art keeps breathing
// while it decodes — the strokes themselves are never overwritten.
void churnNoise(int16_t first_row, int16_t last_row, uint16_t salt) {
  for (uint8_t i = 0; i < 30; i++) {
    const uint16_t noise = wdHash(i, salt, 0x5A5A);
    const uint8_t col = noise % ART_COLS;
    const int16_t row = first_row + (int16_t)((noise >> 6) % (uint16_t)(last_row - first_row + 1));
    if (row < 0 || row >= ART_ROWS || artGlyph(col, (uint8_t)row))
      continue;
    tft.drawChar(ART_X + col * CELL_W, ART_Y + row * CELL_H,
                 (uint8_t)noise_glyphs[(noise >> 11) & 0x0F],
                 ((noise >> 4) & 0x07) ? wdMarkC() : wdEdge(), TFT_BLACK, 1);
  }
}

void drawCarrierNoise(uint16_t salt) {
  for (uint8_t i = 0; i < 70; i++) {
    const uint16_t noise = wdHash(i, salt, 0xA5A5);
    const uint8_t col = noise % ART_COLS;
    const uint8_t row = (noise >> 6) % ART_ROWS;
    tft.drawChar(ART_X + col * CELL_W, ART_Y + row * CELL_H,
                 (uint8_t)noise_glyphs[(noise >> 11) & 0x0F],
                 ((noise >> 4) & 0x07) ? wdGrey() : wdAccentDim(),
                 TFT_BLACK, 1);
  }
}

void drawHeader(int16_t width) {
  const int16_t badgeW = (int16_t)tft.textWidth("SHARKDIV", 2) + 10;
  tft.fillRect(0, 0, width, 22, TFT_BLACK);
  tft.fillRect(0, 0, badgeW, 20, wdAccent());
  tft.setTextDatum(MC_DATUM);
  tft.setTextColor(TFT_BLACK, wdAccent());
  tft.drawString("SHARKDIV", badgeW / 2, 10, 2);
  tft.setTextDatum(ML_DATUM);
  tft.setTextColor(wdAccent(), TFT_BLACK);
  tft.drawString("// ctOS", badgeW + 6, 10, 1);
  tft.setTextDatum(MR_DATUM);
  tft.setTextColor(wdWarn(), TFT_BLACK);
  tft.drawString(String("SYS ") + ESP32DIV_VERSION, width - 6, 10, 1);
  tft.setTextDatum(TL_DATUM);
  tft.drawFastHLine(0, 21, width, wdEdge());
  tft.drawFastHLine(0, 21, badgeW, wdAccent());
}

void drawStatus(const char* message, uint16_t color) {
  tft.fillRect(0, 268, tft.width(), 9, TFT_BLACK);
  tft.setTextDatum(ML_DATUM);
  tft.setTextColor(wdAccent(), TFT_BLACK);
  tft.drawString(">", ART_X, 272, 1);
  tft.setTextColor(color, TFT_BLACK);
  tft.drawString(message, ART_X + 12, 272, 1);
  tft.setTextDatum(TL_DATUM);
}

// One bar cell per art column, so the readout lines up with the artwork.
void drawProgress(uint8_t complete) {
  for (uint8_t i = 0; i < ART_COLS; i++) {
    const bool on = i < complete;
    tft.drawChar(ART_X + i * CELL_W, 286, on ? 0xDB : 0xB0,
                 on ? wdAccent() : wdEdge(), TFT_BLACK, 1);
  }
}

void drawFooter(int16_t width) {
  for (int16_t i = 0; i < ART_COLS * CELL_W; i += 3)
    tft.drawPixel(ART_X + i, 300, wdEdge());
  tft.setTextDatum(MC_DATUM);
  tft.setTextColor(wdGrey(), TFT_BLACK);
  tft.drawString("ESP32-DIV V2  //  BASE: CIFERTECH", width / 2, 310, 1);
  tft.setTextDatum(TL_DATUM);
}

// The wordmark sits on its own plate under the art.
void drawWordMarkAt(int16_t y, bool framed) {
  const char* wordmark = "SHARKDIV";
  const int16_t mark_w = (int16_t)strlen(wordmark) * CELL_W * 2;
  const int16_t x = (tft.width() - mark_w) / 2;
  tft.fillRect(x - 8, y - 4, mark_w + 16, CELL_H + 9, TFT_BLACK);
  if (framed) {
    tft.drawRect(x - 8, y - 4, mark_w + 16, CELL_H + 9, wdEdge());
    wdCornerTicks(x - 8, y - 4, mark_w + 16, CELL_H + 9, 5, wdAccent());
  }
  tft.setTextDatum(TL_DATUM);
  tft.setTextColor(wdAccent(), TFT_BLACK);
  tft.drawString(wordmark, x, y, 2);
}

// Two sliced bands per frame: blanked, redrawn shifted, then restored.
const uint8_t GLITCH_BANDS = 2;
const int16_t GLITCH_HEIGHT = 2;

int16_t glitchRow(uint8_t band, uint16_t salt) {
  return (int16_t)(wdHash(band, salt, 0x3C3C) % (ART_ROWS - GLITCH_HEIGHT));
}

void drawGlitch(uint16_t salt) {
  for (uint8_t band = 0; band < GLITCH_BANDS; band++) {
    const uint16_t noise = wdHash(band, salt, 0x3C3C);
    const int16_t row = glitchRow(band, salt);
    const int16_t dx = ((noise >> 5) & 0x01) ? 4 : -4;
    clearRows(row, GLITCH_HEIGHT);
    drawArtRows(row, row + GLITCH_HEIGHT - 1, 0xFFFF, dx);
    churnNoise(row, row + GLITCH_HEIGHT - 1, salt);
  }
}

void restoreGlitch(uint16_t salt) {
  for (uint8_t band = 0; band < GLITCH_BANDS; band++) {
    const int16_t row = glitchRow(band, salt);
    clearRows(row, GLITCH_HEIGHT);
    drawArtRows(row, row + GLITCH_HEIGHT - 1, wdAccent());
  }
}

}  // namespace

// ═══════════════════════════════════════════════ Skull Rain boot ═══
// The user's "ASCII Skull Rain" screen: the skull melts down the screen,
// green matrix rain falls, and every drop that passes a cell of the second
// skull locks its character in. Ported from ~/Downloads/ascii_skull_rain.ino
// (fonts and skulls verbatim), with the boot's phosphor-green palette.
namespace SkullRain {

static const uint8_t FONT8x16[101][16] PROGMEM = {
  {0x00,0x00,0x00,0x00,0x00,0x00,0x00,0x00,0x00,0x00,0x00,0x00,0x00,0x00,0x00,0x00},  //  
  {0x18,0x18,0x18,0x18,0x18,0x18,0x18,0x00,0x00,0x18,0x18,0x18,0x00,0x00,0x00,0x00},  // !
  {0x00,0x66,0x66,0x66,0x66,0x24,0x00,0x00,0x00,0x00,0x00,0x00,0x00,0x00,0x00,0x00},  // "
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  {0x00,0x00,0x00,0x00,0x00,0x18,0x18,0x18,0x00,0x00,0x00,0x00,0x00,0x00,0x00,0x00},  // #132
};
static const uint8_t FONT6x12[101][12] PROGMEM = {
  {0x00,0x00,0x00,0x00,0x00,0x00,0x00,0x00,0x00,0x00,0x00,0x00},  //  
  {0x00,0x30,0x30,0x30,0x30,0x00,0x00,0x30,0x30,0x00,0x00,0x00},  // !
  {0x00,0x78,0x48,0x48,0x48,0x00,0x00,0x00,0x00,0x00,0x00,0x00},  // "
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  {0x00,0x00,0x00,0x00,0x30,0x30,0x00,0x00,0x00,0x00,0x00,0x00},  // #132
};

struct Skull { const char* name; const char* const* lines; uint8_t n; uint8_t curR, curC; };
static const char* const SKULL_A[] = {
  "         _.,,,.._",
  "      ,d$$$$$$$SSIi:.",
  "    ,S$$$$$$$$$$$$SIIi:.",
  "   jI$$$$$$$$$$$$$SISSi:.",
  "  ,S$$$$$$$$$$$$$$$$$$Ii:",
  " j\177?$$$$$$$$$$$$$$$S$$Ii",
  " :  ?$$$$$$$$$$S7IISS$$I:",
  "j_ /$$7`\2014$$$$7:iIS$$$$I'",
  "\177?\"?$$:   `$k :iIIS$$$7'",
  " \202  ?$L,  ,d$     $$$7'",
  ",d._J$$$$S$$$L,_\203'$$",
  "?$$$$$$k:?$$\177\201,  \201'",
  "\\:`\201\200\177\201^`:jIS7",
  "j$k,i;/_,oSSI'",
  "?SSS$$$$$?\177`",
  " `\177\200\177\201\"`"
};
static const char* const SKULL_B[] = {
  "           __",
  "       ,gS$$$Sk.",
  "     ,d$$$$$$$$$$k.",
  "   ,?^?$7\201` `?$SS$$L.",
  "  ,?  $SL._ ,d$iIS$$SL",
  " j$Su%$$S$$$$$?:iIS$$Sb",
  ":?\200?^4$S$$\"\200?$$L:iIS$SI:",
  ":'   '/`?$'\204  `?LiS$$SI:",
  " `.     '   _   ?kiSSI?",
  "   :.      $k  _ `?Si7",
  "  .,_,_    i$S%7\204:i?'",
  "  ?%uS%uo.d$$?'\204?\177`",
  "  S$$$$$$$$$$i",
  " \204?$$S?"
};
static const Skull SKULLS[2] = {
  { "skull11.txt", SKULL_A, sizeof(SKULL_A) / sizeof(SKULL_A[0]), 5, 19 },
  { "skull.txt",   SKULL_B, sizeof(SKULL_B) / sizeof(SKULL_B[0]), 11, 9 },
};

static int CW, CH, BAR_H, COLS, ROWS, OX, OY, SW, SH;
static const uint8_t* FONT;

enum { A_GLYPH = 0, A_CURSOR, A_HEAD, A_FLASH, A_T1, A_T2, A_T3 };
static uint16_t PAL[7];
static uint16_t C_BAR, C_BLACK;

static uint8_t* skullGrid[2];
static uint8_t* gch;
static uint8_t* gattr;

struct Drop { float t0, speed; uint8_t len; bool on; };
struct Column { float melt0; Drop main, extra; };
static Column* colv;

static const char RAIN[] = "$S7?Ii!;:,.`'jdLk%\177\201";
static const int NRAIN = sizeof(RAIN) - 1;
static const float GRAVITY = 70.0f;

static TFT_eSprite* s_spr = nullptr;
static bool s_sprOk = false;

static inline float frand() { return (float)(esp_random() & 0xFFFFFF) / 16777216.0f; }
static inline uint8_t rainGlyph(int c, int r, int slot) {
  uint32_t h = (uint32_t)c * 73856093u ^ (uint32_t)r * 19349663u ^ (uint32_t)slot * 83492791u;
  h ^= h >> 13; h *= 0x5bd1e995u; h ^= h >> 15;
  return (uint8_t)RAIN[h % NRAIN];
}

static void drawGlyphPx(int x0, int y0, uint8_t ch, uint16_t fg) {
  if (ch < 33 || ch > 132) return;
  const uint8_t* g = FONT + (ch - 32) * CH;
  for (int y = 0; y < CH; y++) {
    uint8_t b = pgm_read_byte(g + y);
    if (!b) continue;
    for (int x = 0; x < CW; x++)
      if (b & (0x80 >> x)) s_spr->drawPixel(x0 + x, y0 + y, fg);
  }
}

static void drawModeline(const char* name, bool arrow) {
  s_spr->fillRect(0, SH - BAR_H, SW, BAR_H, C_BAR);
  char buf[48];
  snprintf(buf, sizeof(buf), arrow ? "-UUU:**--F1  >> %s" : "-UUU:**--F1  %s", name);
  int x = CW / 2;
  for (const char* s2 = buf; *s2; s2++, x += CW) drawGlyphPx(x, SH - BAR_H, (uint8_t)*s2, C_BLACK);
}

static void flushGrid() {
  for (int r = 0; r < ROWS; r++)
    for (int c = 0; c < COLS; c++) {
      int k = r * COLS + c;
      int x = OX + c * CW, y = OY + r * CH;
      if (gattr[k] == A_CURSOR) {
        s_spr->fillRect(x, y, CW, CH, PAL[A_GLYPH]);
        drawGlyphPx(x, y, gch[k], C_BLACK);
      } else if (gch[k] != ' ') {
        drawGlyphPx(x, y, gch[k], PAL[gattr[k]]);
      }
    }
}

static void clearGrid() {
  memset(gch, ' ', COLS * ROWS);
  memset(gattr, A_GLYPH, COLS * ROWS);
}

static void layoutSkull(int k) {
  const Skull& s = SKULLS[k];
  int w = 0;
  for (int r = 0; r < s.n; r++) w = max(w, (int)strlen(s.lines[r]));
  int ox = (COLS - w) / 2, oy = (ROWS - s.n) / 2;
  skullGrid[k] = (uint8_t*)malloc(COLS * ROWS);
  memset(skullGrid[k], ' ', COLS * ROWS);
  for (int r = 0; r < s.n; r++)
    for (int c = 0; s.lines[r][c]; c++)
      skullGrid[k][(r + oy) * COLS + (c + ox)] = (uint8_t)s.lines[r][c];
}

static float morphEnd = 0;
static uint32_t morphStart = 0;

static void startMorph() {
  morphEnd = 0;
  for (int c = 0; c < COLS; c++) {
    Column& col = colv[c];
    bool hasNew = false;
    for (int r = 0; r < ROWS; r++) if (skullGrid[1][r * COLS + c] != ' ') { hasNew = true; break; }
    col.melt0 = (float)c / COLS * 0.45f + frand() * 0.3f;
    col.main.t0 = col.melt0 + 0.35f + frand() * 0.35f;
    col.main.speed = 16 + frand() * 10;
    col.main.len = 6 + (esp_random() % 8);
    col.main.on = hasNew || frand() < 0.6f;
    col.extra.t0 = col.main.t0 + 0.3f + frand() * 0.7f;
    col.extra.speed = 20 + frand() * 12;
    col.extra.len = 3 + (esp_random() % 5);
    col.extra.on = frand() < 0.55f;
    float mainEnd = col.main.t0 + (ROWS + col.main.len + 2) / col.main.speed;
    float extraEnd = col.extra.on ? col.extra.t0 + (ROWS + col.extra.len + 2) / col.extra.speed : 0;
    float meltEnd = col.melt0 + ROWS * 0.025f + sqrtf(2.0f * ROWS / GRAVITY) + 0.1f;
    morphEnd = fmaxf(morphEnd, fmaxf(mainEnd, fmaxf(extraEnd, meltEnd)));
  }
  morphStart = millis();
}

static inline float headRow(const Drop& d, float tau) { return (tau - d.t0) * d.speed - 1; }

static void drawDrop(int c, const Drop& d, float tau, int slot, bool bright) {
  if (!d.on || tau < d.t0) return;
  int h = (int)floorf(headRow(d, tau));
  const uint8_t* nw = skullGrid[1];
  for (int k = 0; k <= d.len; k++) {
    int r = h - k;
    if (r < 0 || r >= ROWS) continue;
    int i = r * COLS + c;
    bool locked = nw[i] != ' ' && r < headRow(colv[c].main, tau);
    if (k == 0) {
      gch[i] = rainGlyph(c, r, slot);
      gattr[i] = A_HEAD;
    } else if (locked) {
      gch[i] = nw[i];
      gattr[i] = k <= 2 ? A_FLASH : A_GLYPH;
    } else {
      gch[i] = rainGlyph(c, r, slot + k);
      float f = (float)k / d.len;
      gattr[i] = f < 0.34f ? A_T1 : (f < 0.67f ? A_T2 : A_T3);
      if (!bright && gattr[i] == A_T1) gattr[i] = A_T2;
    }
  }
}

static void drawStatic(int which) {
  clearGrid();
  memcpy(gch, skullGrid[which], COLS * ROWS);
  s_spr->fillSprite(C_BLACK);
  flushGrid();
  drawModeline(SKULLS[which].name, false);
  s_spr->pushSprite(0, 0);
}

static void drawMorph() {
  float tau = (millis() - morphStart) / 1000.0f;
  int slot = (int)(tau * 12);
  const uint8_t* old = skullGrid[0];
  const uint8_t* nw = skullGrid[1];
  clearGrid();

  for (int c = 0; c < COLS; c++) {
    float h = headRow(colv[c].main, tau);
    for (int r = 0; r < ROWS && r < h; r++) {
      int i = r * COLS + c;
      if (nw[i] != ' ') { gch[i] = nw[i]; gattr[i] = A_GLYPH; }
    }
  }
  for (int c = 0; c < COLS; c++) {
    drawDrop(c, colv[c].main, tau, slot, true);
    drawDrop(c, colv[c].extra, tau, slot + 101, false);
  }
  for (int c = 0; c < COLS; c++) {
    for (int r = ROWS - 1; r >= 0; r--) {
      uint8_t ch = old[r * COLS + c];
      if (ch == ' ') continue;
      float start = colv[c].melt0 + (ROWS - 1 - r) * 0.025f;
      int y = r;
      if (tau > start) {
        float dt = tau - start;
        y = (int)lroundf(r + 0.5f * GRAVITY * dt * dt);
        if (((esp_random() & 0xFF) < 90)) ch = rainGlyph(c, r, slot + 7);
      }
      if (y >= ROWS) continue;
      int i = y * COLS + c;
      if (gattr[i] == A_HEAD) continue;
      gch[i] = ch;
      gattr[i] = A_GLYPH;
      if (tau > start + 0.05f && y - 1 >= 0) {
        int j = (y - 1) * COLS + c;
        if (gch[j] == ' ') { gch[j] = rainGlyph(c, y, slot); gattr[j] = A_T3; }
      }
    }
  }

  s_spr->fillSprite(C_BLACK);
  flushGrid();
  drawModeline(SKULLS[1].name, true);
  s_spr->pushSprite(0, 0);
}

// One full boot pass: rest on skull A, melt into skull B under green rain,
// brief hold. ~4 s total.
void run() {
  tft.fillScreen(TFT_BLACK);
  SW = tft.width(); SH = tft.height();
  if (SW >= 25 * 8 && SH >= 18 * 16 + 16) { CW = 8; CH = 16; FONT = &FONT8x16[0][0]; }
  else { CW = 6; CH = 12; FONT = &FONT6x12[0][0]; }
  BAR_H = CH;
  COLS = SW / CW;
  ROWS = (SH - BAR_H) / CH;
  OX = (SW - COLS * CW) / 2;
  OY = (SH - BAR_H - ROWS * CH) / 2;
  if (COLS < 25 || ROWS < 16) return;  // screen too small, skip gracefully

  TFT_eSprite spr(&tft);
  spr.setColorDepth(16);
  s_sprOk = (spr.createSprite(SW, SH) != nullptr);
  s_spr = s_sprOk ? &spr : nullptr;
  if (!s_sprOk) return;  // no memory for the frame buffer: skip the show

  // Phosphor green everything, per the boot palette.
  PAL[A_GLYPH]  = tft.color565(120, 255, 150);
  PAL[A_CURSOR] = PAL[A_GLYPH];
  PAL[A_HEAD]   = tft.color565(220, 255, 220);
  PAL[A_FLASH]  = tft.color565(170, 255, 170);
  PAL[A_T1]     = tft.color565(40, 220, 70);
  PAL[A_T2]     = tft.color565(20, 150, 45);
  PAL[A_T3]     = tft.color565(10, 80, 25);
  C_BAR   = tft.color565(40, 200, 80);
  C_BLACK = TFT_BLACK;

  gch = (uint8_t*)malloc(COLS * ROWS);
  gattr = (uint8_t*)malloc(COLS * ROWS);
  colv = (Column*)calloc(COLS, sizeof(Column));
  layoutSkull(0);
  layoutSkull(1);

  drawStatic(0);
  delay(600);
  startMorph();
  while ((millis() - morphStart) / 1000.0f < morphEnd) {
    drawMorph();
    delay(40);
  }
  drawStatic(1);
  delay(700);

  free(gch); free(gattr); free(colv);
  free(skullGrid[0]); free(skullGrid[1]);
  spr.deleteSprite();
  s_spr = nullptr;
  tft.fillScreen(TFT_BLACK);
}

}  // namespace SkullRain

void playSharkBoot() {
  applyThemeToPalette(settings().theme);

  const int16_t width = tft.width();
  tft.fillScreen(TFT_BLACK);
  drawHeader(width);
  drawFooter(width);
  drawStatus("BOOTING", wdGrey());
  drawProgress(0);

  // The user's Skull Rain screen: melt + green rain, then the logo reveal.
  SkullRain::run();

  // 5. The M5SHARK mark: the shark-head logo wipes in behind a bright scan
  // bar, pulses, and the brand + version settle under it.
  const int16_t LOGO_X = (width - SHARK_LOGO_W) / 2;
  const int16_t LOGO_Y = 58;
  const int16_t logoBytes = (SHARK_LOGO_W + 7) / 8;
  auto logoColumns = [&](int16_t fromX, int16_t toX, uint16_t color) {
    for (int16_t x = fromX; x < toX && x < SHARK_LOGO_W; x++) {
      for (int16_t y = 0; y < SHARK_LOGO_H; y++) {
        const uint8_t bits = pgm_read_byte(&shark_logo_bitmap[y * logoBytes + (x >> 3)]);
        if (bits & (128 >> (x & 7))) {
          tft.drawPixel(LOGO_X + x, LOGO_Y + y, color);
        }
      }
    }
  };

  clearRows(0, ART_ROWS);
  drawStatus("IDENTITY VERIFIED", wdLabel());

  // Wipe the mark in ten bands, bright leading edge, dark fill behind.
  constexpr int16_t kLogoBands = 10;
  const int16_t bandW = SHARK_LOGO_W / kLogoBands;
  for (int16_t band = 0; band < kLogoBands; band++) {
    const int16_t x1 = (band + 1) * bandW;
    logoColumns(band * bandW, x1, wdAccent());
    tft.drawFastVLine(LOGO_X + x1 - 1, LOGO_Y, SHARK_LOGO_H, 0xFFFF);
    delay(24);
    tft.drawFastVLine(LOGO_X + x1 - 1, LOGO_Y, SHARK_LOGO_H, TFT_BLACK);
  }

  // Bright pulse, then settle.
  logoColumns(0, SHARK_LOGO_W, 0xFFFF);
  delay(90);
  logoColumns(0, SHARK_LOGO_W, wdAccent());

  // Brand block under the mark.
  tft.setTextDatum(MC_DATUM);
  tft.setTextColor(wdAccent(), TFT_BLACK);
  tft.drawString("SHARKDIV", width / 2, 218, 3);
  tft.setTextColor(wdContent(), TFT_BLACK);
  tft.drawString(String("ESP32-S3 MULTITOOL  ") + ESP32DIV_VERSION, width / 2, 246, 1);
  tft.setTextDatum(TL_DATUM);
  wdCornerTicks(LOGO_X - 8, LOGO_Y - 8, SHARK_LOGO_W + 16, 140 + 16, 5, wdAccent());
  drawStatus("M5SHARK", wdAccent());
  drawProgress(ART_COLS);
  delay(950);
}
